## conf/layer.conf
```bitbake
# We have a conf and classes directory, add to BBPATH
BBPATH .= ":${LAYERDIR}"

# We have recipes-* directories, add to BBFILES
BBFILES += "${LAYERDIR}/recipes-*/*/*.bb \
	${LAYERDIR}/recipes-*/*/*.bbappend"

BBFILE_COLLECTIONS += "tpc71wn10pa"
BBFILE_PATTERN_tpc71wn10pa = "^${LAYERDIR}/"
BBFILE_PRIORITY_tpc71wn10pa = "12"
```
